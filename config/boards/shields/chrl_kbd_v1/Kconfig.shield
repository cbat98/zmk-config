## config/boards/shields/chrl_kbd_v1/Kconfig.shield
```kconfig
config SHIELD_CHRL_KBD_V1_LEFT
	def_bool $(shields_list_contains,chrl_kbd_v1_left)

config SHIELD_CHRL_KBD_V1_RIGHT
	def_bool $(shields_list_contains,chrl_kbd_v1_right)
```
